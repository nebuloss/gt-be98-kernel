## configs/gtbe98_defconfig
```kconfig
# CONFIG_LOCALVERSION_AUTO is not set
CONFIG_SYSVIPC=y
# CONFIG_CROSS_MEMORY_ATTACH is not set
CONFIG_NO_HZ_IDLE=y
CONFIG_HIGH_RES_TIMERS=y
CONFIG_PREEMPT=y
CONFIG_IKCONFIG=y
CONFIG_IKCONFIG_PROC=y
CONFIG_LOG_CPU_MAX_BUF_SHIFT=14
CONFIG_PRINTK_SAFE_LOG_BUF_SHIFT=15
CONFIG_SYSFS_DEPRECATED=y
CONFIG_SYSFS_DEPRECATED_V2=y
CONFIG_BLK_DEV_INITRD=y
# CONFIG_RD_BZIP2 is not set
# CONFIG_RD_LZMA is not set
# CONFIG_RD_XZ is not set
# CONFIG_RD_LZO is not set
# CONFIG_RD_LZ4 is not set
# CONFIG_SYSFS_SYSCALL is not set
CONFIG_SYSCTL_SYSCALL=y
# CONFIG_FHANDLE is not set
# CONFIG_AIO is not set
# CONFIG_ADVISE_SYSCALLS is not set
CONFIG_EMBEDDED=y
# CONFIG_VM_EVENT_COUNTERS is not set
# CONFIG_COMPAT_BRK is not set
# CONFIG_SLAB_MERGE_DEFAULT is not set
CONFIG_SLAB_FREELIST_RANDOM=y
CONFIG_SLAB_FREELIST_HARDENED=y
CONFIG_PCIEPORTBUS=y
# CONFIG_PCIEAER is not set
CONFIG_NR_CPUS=4
CONFIG_HOTPLUG_CPU=y
CONFIG_HZ_1000=y
CONFIG_ARM64_SW_TTBR0_PAN=y
CONFIG_RANDOMIZE_BASE=y
# CONFIG_EFI is not set
CONFIG_COMPAT=y
# CONFIG_SUSPEND is not set
CONFIG_ARM64_CRYPTO=y
CONFIG_CRYPTO_SHA512_ARM64=y
CONFIG_CRYPTO_SHA1_ARM64_CE=y
CONFIG_CRYPTO_SHA2_ARM64_CE=y
CONFIG_CRYPTO_AES_ARM64_CE_CCM=y
CONFIG_CRYPTO_AES_ARM64_CE_BLK=y
CONFIG_CRYPTO_AES_ARM64_NEON_BLK=y
CONFIG_MODULES=y
CONFIG_MODULE_UNLOAD=y
# CONFIG_BLK_DEV_BSG is not set
CONFIG_PARTITION_ADVANCED=y
CONFIG_MAC_PARTITION=y
CONFIG_LDM_PARTITION=y
# CONFIG_IOSCHED_DEADLINE is not set
# CONFIG_IOSCHED_CFQ is not set
# CONFIG_CORE_DUMP_DEFAULT_ELF_HEADERS is not set
CONFIG_KSM=y
CONFIG_DEFAULT_MMAP_MIN_ADDR=32768
CONFIG_CMA=y
CONFIG_NET=y
CONFIG_PACKET=y
CONFIG_UNIX=y
CONFIG_XFRM_USER=m
CONFIG_NET_KEY=y
CONFIG_INET=y
CONFIG_IP_MULTICAST=y
CONFIG_IP_ADVANCED_ROUTER=y
CONFIG_IP_MULTIPLE_TABLES=y
CONFIG_IP_ROUTE_MULTIPATH=y
CONFIG_IP_ROUTE_VERBOSE=y
CONFIG_NET_IPGRE_DEMUX=y
CONFIG_NET_IPGRE=y
CONFIG_NET_IPGRE_BROADCAST=y
CONFIG_IP_MROUTE=y
CONFIG_IP_MROUTE_MULTIPLE_TABLES=y
CONFIG_IP_PIMSM_V1=y
CONFIG_IP_PIMSM_V2=y
CONFIG_SYN_COOKIES=y
CONFIG_NET_IPVTI=y
CONFIG_INET_AH=m
CONFIG_INET_ESP=m
CONFIG_INET_IPCOMP=m
# CONFIG_INET_DIAG is not set
CONFIG_IPV6_ROUTER_PREF=y
CONFIG_INET6_AH=y
CONFIG_INET6_ESP=y
CONFIG_INET6_IPCOMP=y
CONFIG_IPV6_VTI=y
CONFIG_IPV6_SIT_6RD=y
CONFIG_IPV6_GRE=y
CONFIG_IPV6_MULTIPLE_TABLES=y
CONFIG_IPV6_MROUTE=y
CONFIG_IPV6_PIMSM_V2=y
CONFIG_NETFILTER=y
CONFIG_NF_CONNTRACK=y
CONFIG_NF_CONNTRACK_PROCFS=y
CONFIG_NF_CONNTRACK_EVENTS=y
# CONFIG_NF_CT_PROTO_DCCP is not set
# CONFIG_NF_CT_PROTO_UDPLITE is not set
CONFIG_NF_CONNTRACK_FTP=m
CONFIG_NF_CONNTRACK_H323=m
CONFIG_NF_CONNTRACK_PPTP=y
CONFIG_NF_CONNTRACK_SIP=m
CONFIG_NF_CONNTRACK_TFTP=m
CONFIG_NF_CT_NETLINK=y
CONFIG_NETFILTER_NETLINK_GLUE_CT=y
CONFIG_NF_TABLES=m
CONFIG_NETFILTER_XT_SET=y
CONFIG_NETFILTER_XT_TARGET_CLASSIFY=y
CONFIG_NETFILTER_XT_TARGET_CONNMARK=y
CONFIG_NETFILTER_XT_TARGET_DSCP=y
CONFIG_NETFILTER_XT_TARGET_HL=m
CONFIG_NETFILTER_XT_TARGET_LOG=y
CONFIG_NETFILTER_XT_TARGET_IMQ=y
CONFIG_NETFILTER_XT_TARGET_MARK=y
CONFIG_NETFILTER_XT_TARGET_NFLOG=y
CONFIG_NETFILTER_XT_TARGET_NFQUEUE=y
CONFIG_NETFILTER_XT_TARGET_NOTRACK=y
CONFIG_NETFILTER_XT_TARGET_TEE=m
CONFIG_NETFILTER_XT_TARGET_TPROXY=m
CONFIG_NETFILTER_XT_TARGET_TCPMSS=y
CONFIG_NETFILTER_XT_MATCH_ADDRTYPE=y
CONFIG_NETFILTER_XT_MATCH_COMMENT=m
CONFIG_NETFILTER_XT_MATCH_CONNBYTES=y
CONFIG_NETFILTER_XT_MATCH_CONNLIMIT=y
CONFIG_NETFILTER_XT_MATCH_CONNMARK=y
CONFIG_NETFILTER_XT_MATCH_CONNTRACK=y
CONFIG_NETFILTER_XT_MATCH_DSCP=y
CONFIG_NETFILTER_XT_MATCH_HASHLIMIT=m
CONFIG_NETFILTER_XT_MATCH_HELPER=y
CONFIG_NETFILTER_XT_MATCH_HL=m
CONFIG_NETFILTER_XT_MATCH_IPRANGE=y
# CONFIG_NETFILTER_XT_MATCH_L2TP is not set
CONFIG_NETFILTER_XT_MATCH_LENGTH=m
CONFIG_NETFILTER_XT_MATCH_LIMIT=y
CONFIG_NETFILTER_XT_MATCH_MAC=y
CONFIG_NETFILTER_XT_MATCH_MARK=y
CONFIG_NETFILTER_XT_MATCH_MULTIPORT=y
CONFIG_NETFILTER_XT_MATCH_POLICY=y
CONFIG_NETFILTER_XT_MATCH_PKTTYPE=m
CONFIG_NETFILTER_XT_MATCH_QUOTA=m
CONFIG_NETFILTER_XT_MATCH_RECENT=y
CONFIG_NETFILTER_XT_MATCH_SCTP=m
CONFIG_NETFILTER_XT_MATCH_SOCKET=m
CONFIG_NETFILTER_XT_MATCH_STATE=y
CONFIG_NETFILTER_XT_MATCH_STATISTIC=y
CONFIG_NETFILTER_XT_MATCH_STRING=y
CONFIG_NETFILTER_XT_MATCH_TCPMSS=y
CONFIG_NETFILTER_XT_MATCH_TIME=y
CONFIG_NETFILTER_XT_MATCH_U32=y
CONFIG_NETFILTER_XT_MATCH_WEBSTR=y
CONFIG_NETFILTER_XT_MATCH_CONDITION=m
CONFIG_NETFILTER_XT_MATCH_GEOIP=m
CONFIG_IP_SET=y
CONFIG_IP_SET_BITMAP_IP=y
CONFIG_IP_SET_BITMAP_IPMAC=y
CONFIG_IP_SET_BITMAP_PORT=y
CONFIG_IP_SET_HASH_IP=y
CONFIG_IP_SET_HASH_IPMARK=y
CONFIG_IP_SET_HASH_IPPORT=y
CONFIG_IP_SET_HASH_IPPORTIP=y
CONFIG_IP_SET_HASH_IPPORTNET=y
CONFIG_IP_SET_HASH_IPMAC=y
CONFIG_IP_SET_HASH_MAC=y
CONFIG_IP_SET_HASH_NETPORTNET=y
CONFIG_IP_SET_HASH_NET=y
CONFIG_IP_SET_HASH_NETNET=y
CONFIG_IP_SET_HASH_NETPORT=y
CONFIG_IP_SET_HASH_NETIFACE=y
CONFIG_IP_SET_LIST_SET=y
CONFIG_NF_TABLES_ARP=y
CONFIG_IP_NF_TARGET_TOS=m
CONFIG_IP_NF_TARGET_TRIGGER=y
CONFIG_IP_NF_IPTABLES=y
CONFIG_IP_NF_MATCH_TOS=m
CONFIG_IP_NF_MATCH_IPP2P=m
CONFIG_IP_NF_MATCH_WEBMON=m
CONFIG_IP_NF_MATCH_WEB=m
CONFIG_IP_NF_FILTER=y
CONFIG_IP_NF_TARGET_REJECT=y
CONFIG_IP_NF_NAT=y
CONFIG_IP_NF_TARGET_MASQUERADE=y
CONFIG_IP_NF_TARGET_NETMAP=y
CONFIG_IP_NF_TARGET_REDIRECT=y
CONFIG_IP_NF_MANGLE=y
CONFIG_IP_NF_RAW=y
CONFIG_IP_NF_DNSMQ=y
CONFIG_IP6_NF_IPTABLES=y
CONFIG_IP6_NF_MATCH_RT=y
CONFIG_IP6_NF_FILTER=y
CONFIG_IP6_NF_TARGET_REJECT=y
CONFIG_IP6_NF_MANGLE=y
CONFIG_IP6_NF_RAW=y
CONFIG_IP6_NF_NAT=y
CONFIG_IP6_NF_TARGET_MASQUERADE=y
CONFIG_IP6_NF_TARGET_NPT=y
CONFIG_BRIDGE_NF_EBTABLES=y
CONFIG_BRIDGE_EBT_BROUTE=y
CONFIG_BRIDGE_EBT_T_FILTER=y
CONFIG_BRIDGE_EBT_T_NAT=y
CONFIG_BRIDGE_EBT_ARP=y
CONFIG_BRIDGE_EBT_IP=y
CONFIG_BRIDGE_EBT_IP6=y
CONFIG_BRIDGE_EBT_LIMIT=y
CONFIG_BRIDGE_EBT_MARK=y
CONFIG_BRIDGE_EBT_PKTTYPE=y
CONFIG_BRIDGE_EBT_STP=y
CONFIG_BRIDGE_EBT_VLAN=y
CONFIG_BRIDGE_EBT_ARPREPLY=y
CONFIG_BRIDGE_EBT_DNAT=y
CONFIG_BRIDGE_EBT_MARK_T=y
CONFIG_BRIDGE_EBT_REDIRECT=y
CONFIG_BRIDGE_EBT_SNAT=y
CONFIG_BRIDGE_EBT_LOG=y
CONFIG_IP_SCTP=y
CONFIG_L2TP=y
CONFIG_BRIDGE=y
# CONFIG_BRIDGE_IGMP_SNOOPING is not set
CONFIG_VLAN_8021Q=y
CONFIG_NET_SCHED=y
CONFIG_NET_SCH_CBQ=y
CONFIG_NET_SCH_HTB=y
CONFIG_NET_SCH_HFSC=m
CONFIG_NET_SCH_PRIO=y
CONFIG_NET_SCH_SFQ=y
CONFIG_NET_SCH_TBF=y
CONFIG_NET_SCH_DSMARK=y
CONFIG_NET_SCH_FQ_CODEL=y
CONFIG_NET_SCH_CAKE=y
CONFIG_NET_SCH_INGRESS=y
CONFIG_NET_CLS_BASIC=y
CONFIG_NET_CLS_ROUTE4=y
CONFIG_NET_CLS_FW=y
CONFIG_NET_CLS_U32=y
CONFIG_CLS_U32_PERF=y
CONFIG_CLS_U32_MARK=y
CONFIG_NET_CLS_FLOW=y
CONFIG_NET_CLS_FLOWER=y
CONFIG_NET_CLS_MATCHALL=y
CONFIG_NET_EMATCH=y
CONFIG_NET_EMATCH_CMP=m
CONFIG_NET_EMATCH_NBYTE=m
CONFIG_NET_EMATCH_U32=m
CONFIG_NET_EMATCH_META=m
CONFIG_NET_EMATCH_TEXT=m
CONFIG_NET_EMATCH_IPSET=m
CONFIG_NET_EMATCH_IPT=m
CONFIG_NET_CLS_ACT=y
CONFIG_NET_ACT_POLICE=y
CONFIG_NET_ACT_GACT=y
CONFIG_NET_ACT_MIRRED=y
CONFIG_NET_ACT_SAMPLE=y
CONFIG_NET_ACT_PEDIT=y
CONFIG_NET_ACT_SIMP=y
CONFIG_NET_ACT_SKBEDIT=y
CONFIG_NET_ACT_CSUM=y
CONFIG_NET_ACT_VLAN=y
CONFIG_NET_ACT_CONNMARK=y
CONFIG_NET_ACT_SKBMOD=y
CONFIG_NET_CLS_IND=y
CONFIG_DNS_RESOLVER=m
CONFIG_NET_SWITCHDEV=y
CONFIG_CFG80211=m
CONFIG_NL80211_TESTMODE=y
CONFIG_DEVTMPFS=y
CONFIG_DEVTMPFS_MOUNT=y
CONFIG_FW_LOADER=m
# CONFIG_ALLOW_DEV_COREDUMP is not set
CONFIG_DMA_CMA=y
CONFIG_CMA_SIZE_MBYTES=0
CONFIG_MTD=y
CONFIG_MTD_CMDLINE_PARTS=y
CONFIG_MTD_OOPS=m
CONFIG_MTD_PARTITIONED_MASTER=y
CONFIG_MTD_ROM=y
CONFIG_MTD_COMPLEX_MAPPINGS=y
CONFIG_MTD_M25P80=y
CONFIG_MTD_NAND=y
CONFIG_MTD_NAND_BRCMNAND=y
CONFIG_MTD_SPI_NAND=y
CONFIG_MTD_SPI_NOR=y
CONFIG_MTD_UBI=y
CONFIG_MTD_UBI_GLUEBI=y
CONFIG_MTD_UBI_BLOCK=y
CONFIG_BLK_DEV_LOOP=y
CONFIG_BLK_DEV_LOOP_MIN_COUNT=4
CONFIG_BLK_DEV_RAM=y
CONFIG_BLK_DEV_RAM_COUNT=1
CONFIG_BLK_DEV_RAM_SIZE=8192
CONFIG_SCSI=m
# CONFIG_SCSI_MQ_DEFAULT is not set
CONFIG_BLK_DEV_SD=m
CONFIG_BLK_DEV_SR=m
CONFIG_CHR_DEV_SG=m
CONFIG_SCSI_CONSTANTS=y
# CONFIG_SCSI_LOWLEVEL is not set
CONFIG_NETDEVICES=y
CONFIG_BONDING=m
CONFIG_IFB=y
CONFIG_VXLAN=y
CONFIG_IMQ_NUM_DEVS=3
CONFIG_TUN=m
# CONFIG_ETHERNET is not set
CONFIG_PHYLIB=y
CONFIG_PPP=y
CONFIG_PPP_BSDCOMP=y
CONFIG_PPP_DEFLATE=y
CONFIG_PPP_MPPE=y
CONFIG_PPP_MULTILINK=y
CONFIG_PPPOE=y
CONFIG_PPTP=y
CONFIG_PPPOL2TP=y
CONFIG_PPP_ASYNC=y
CONFIG_PPP_SYNC_TTY=y
CONFIG_USB_USBNET=m
# CONFIG_USB_NET_NET1080 is not set
CONFIG_USB_NET_RNDIS_HOST=m
# CONFIG_USB_NET_CDC_SUBSET is not set
# CONFIG_USB_NET_ZAURUS is not set
CONFIG_USB_NET_QMI_WWAN=m
CONFIG_USB_IPHETH=m
CONFIG_WIRELESS_WDS=y
# CONFIG_WLAN_VENDOR_ADMTEK is not set
# CONFIG_WLAN_VENDOR_ATH is not set
# CONFIG_WLAN_VENDOR_ATMEL is not set
# CONFIG_WLAN_VENDOR_BROADCOM is not set
# CONFIG_WLAN_VENDOR_CISCO is not set
# CONFIG_WLAN_VENDOR_INTEL is not set
# CONFIG_WLAN_VENDOR_INTERSIL is not set
# CONFIG_WLAN_VENDOR_MARVELL is not set
# CONFIG_WLAN_VENDOR_MEDIATEK is not set
# CONFIG_WLAN_VENDOR_RALINK is not set
# CONFIG_WLAN_VENDOR_REALTEK is not set
# CONFIG_WLAN_VENDOR_RSI is not set
# CONFIG_WLAN_VENDOR_ST is not set
# CONFIG_WLAN_VENDOR_TI is not set
# CONFIG_WLAN_VENDOR_ZYDAS is not set
# CONFIG_WLAN_VENDOR_QUANTENNA is not set
CONFIG_INPUT_EVDEV=y
# CONFIG_VT is not set
CONFIG_LEGACY_PTY_COUNT=16
CONFIG_SERIAL_AMBA_PL011=y
CONFIG_SERIAL_AMBA_PL011_CONSOLE=y
CONFIG_HW_RANDOM=y
# CONFIG_DEVPORT is not set
CONFIG_I2C=y
# CONFIG_I2C_COMPAT is not set
CONFIG_I2C_CHARDEV=y
# CONFIG_I2C_HELPER_AUTO is not set
CONFIG_SPI=y
CONFIG_SPI_BCMBCA_HSSPI=y
CONFIG_SPI_SPIDEV=y
# CONFIG_HWMON is not set
CONFIG_THERMAL=y
CONFIG_THERMAL_GOV_BANG_BANG=y
CONFIG_WATCHDOG=y
CONFIG_WATCHDOG_CORE=y
CONFIG_WATCHDOG_SYSFS=y
CONFIG_BCM96XXX_WDT=y
CONFIG_WATCHDOG_PRETIMEOUT_GOV=y
CONFIG_WATCHDOG_PRETIMEOUT_DEFAULT_GOV_NOOP=y
CONFIG_REGULATOR=y
CONFIG_REGULATOR_FIXED_VOLTAGE=y
# CONFIG_VGA_ARB is not set
CONFIG_HIDRAW=y
CONFIG_USB_HIDDEV=y
CONFIG_USB=m
# CONFIG_USB_DEFAULT_PERSIST is not set
CONFIG_USB_LEDS_TRIGGER_USBPORT=m
CONFIG_USB_MON=m
CONFIG_USB_XHCI_HCD=m
CONFIG_USB_XHCI_PLATFORM=m
CONFIG_USB_EHCI_HCD=m
# CONFIG_USB_EHCI_TT_NEWSCHED is not set
CONFIG_USB_EHCI_HCD_PLATFORM=m
CONFIG_USB_OHCI_HCD=m
CONFIG_USB_OHCI_HCD_PLATFORM=m
CONFIG_USB_ACM=m
CONFIG_USB_PRINTER=m
CONFIG_USB_STORAGE=m
CONFIG_USB_UAS=m
CONFIG_USB_SERIAL=m
CONFIG_USB_SERIAL_GENERIC=y
CONFIG_USB_SERIAL_OPTION=m
CONFIG_MMC=y
CONFIG_MMC_BLOCK_MINORS=32
CONFIG_MMC_TEST=y
CONFIG_MMC_SDHCI=y
CONFIG_MMC_SDHCI_PLTFM=y
CONFIG_MMC_SDHCI_BCM63xx=y
CONFIG_LEDS_TRIGGERS=y
CONFIG_LEDS_TRIGGER_TIMER=y
CONFIG_LEDS_TRIGGER_DEFAULT_ON=y
# CONFIG_COMMON_CLK_XGENE is not set
# CONFIG_IOMMU_SUPPORT is not set
CONFIG_IIO=y
CONFIG_IIO_BUFFER=y
CONFIG_IIO_KFIFO_BUF=y
CONFIG_IIO_TRIGGER=y
CONFIG_EXT4_FS=y
CONFIG_EXT4_FS_POSIX_ACL=y
CONFIG_EXT4_FS_SECURITY=y
CONFIG_AUTOFS4_FS=y
CONFIG_FUSE_FS=y
CONFIG_PROC_KCORE=y
CONFIG_TMPFS=y
CONFIG_CONFIGFS_FS=y
CONFIG_JFFS2_FS=y
CONFIG_UBIFS_FS=y
# CONFIG_UBIFS_FS_XATTR is not set
CONFIG_SQUASHFS=y
CONFIG_SQUASHFS_XZ=y
CONFIG_SQUASHFS_EMBEDDED=y
CONFIG_CIFS=m
# CONFIG_CIFS_ALLOW_INSECURE_LEGACY is not set
# CONFIG_CIFS_DEBUG is not set
CONFIG_NLS=y
CONFIG_NLS_DEFAULT="utf8"
CONFIG_NLS_CODEPAGE_437=m
CONFIG_NLS_CODEPAGE_850=m
CONFIG_NLS_CODEPAGE_852=m
CONFIG_NLS_CODEPAGE_866=m
CONFIG_NLS_CODEPAGE_936=m
CONFIG_NLS_CODEPAGE_950=m
CONFIG_NLS_CODEPAGE_932=m
CONFIG_NLS_CODEPAGE_949=m
CONFIG_HARDENED_USERCOPY=y
CONFIG_FORTIFY_SOURCE=y
CONFIG_CRYPTO_CCM=y
CONFIG_CRYPTO_GCM=y
CONFIG_CRYPTO_XTS=y
CONFIG_CRYPTO_CMAC=y
CONFIG_CRYPTO_MD4=y
CONFIG_CRYPTO_SHA512=y
# CONFIG_CRYPTO_HW is not set
# CONFIG_XZ_DEC_X86 is not set
# CONFIG_XZ_DEC_POWERPC is not set
# CONFIG_XZ_DEC_IA64 is not set
# CONFIG_XZ_DEC_ARM is not set
# CONFIG_XZ_DEC_ARMTHUMB is not set
# CONFIG_XZ_DEC_SPARC is not set
# CONFIG_ENABLE_MUST_CHECK is not set
CONFIG_DEBUG_FS=y
CONFIG_MAGIC_SYSRQ=y
CONFIG_PAGE_POISONING=y
CONFIG_SOFTLOCKUP_DETECTOR=y
CONFIG_BOOTPARAM_SOFTLOCKUP_PANIC=y
# CONFIG_DETECT_HUNG_TASK is not set
CONFIG_PANIC_ON_OOPS=y
CONFIG_PANIC_TIMEOUT=5
# CONFIG_SCHED_DEBUG is not set
CONFIG_SCHED_STACK_END_CHECK=y
# CONFIG_DEBUG_PREEMPT is not set
CONFIG_STACKTRACE=y
CONFIG_RCU_CPU_STALL_TIMEOUT=60
# CONFIG_FTRACE is not set
CONFIG_BUG_ON_DATA_CORRUPTION=y
CONFIG_DEBUG_WX=y
CONFIG_BCM_CHIP_NUMBER=6813
CONFIG_BRCM_CHIP_REV=0x6813A0
CONFIG_BCM96813=y
CONFIG_BCM_PROC_CPU_AFFINITY_HINT=y
CONFIG_BCM_BOARD=y
CONFIG_BCM_PLATFORM=y
CONFIG_BCM_OTP=m
CONFIG_BCM_EXT_TIMER=y
CONFIG_ACCEL_PPTP=y
CONFIG_BCM_ACCEL=y
CONFIG_BCM_MAX_UCAST_FLOWS=16384
CONFIG_BCM_MAX_MCAST_GROUPS=128
CONFIG_BCM_MAX_MCAST_CLIENTS_PER_GROUP=64
CONFIG_BCM_MAX_MCAST_CLIENTS=1024
CONFIG_BCM_UNKNOWN_UCAST=y
CONFIG_BCM_MAX_UNKNOWN_UCAST_GROUPS=16
CONFIG_BCM_MAX_UNKNOWN_UCAST_CLIENTS_PER_GROUP=16
CONFIG_BCM_MAX_UNKNOWN_UCAST_CLIENTS=256
CONFIG_BCM_MAX_FDB=1024
CONFIG_BCM_MAX_HOST_DEV=64
CONFIG_BCM_MAX_HOST_MAC=32
CONFIG_BCM_PKTFLOW=m
CONFIG_BCM_FHW=y
CONFIG_BCM_PKTRUNNER=m
CONFIG_BCM_RUNNER_FRAG_GATHER=y
CONFIG_BCM_RUNNER_GSO=y
CONFIG_BCM_SW_GSO=y
CONFIG_BCM_SW_GSO_THREAD=m
CONFIG_BCM_CSO=y
CONFIG_BCM_CMDLIST=m
CONFIG_BCM_CMDLIST_XPE=y
CONFIG_BCM_INGQOS=m
CONFIG_BCM_MPM=m
CONFIG_BCM_BPM=m
CONFIG_BCM_BPM_SW_ONLY=y
CONFIG_BCM_RDPA_TM_C=y
CONFIG_BCM_BPM_DYNAMIC=y
CONFIG_BCM_BPM_DYNAMIC_PRCNT_MAX_BUF=15
CONFIG_BCM_BPM_DYNAMIC_PRCNT_INIT_BUF=3
CONFIG_BCM_BPM_DYNAMIC_AVAIL_LOW_TH=512
CONFIG_BCM_BPM_DYNAMIC_EXPAND_STEP_SIZE=128
CONFIG_BCM_BPM_DYNAMIC_SHRINK_STEP_SIZE=32
CONFIG_BCM_BPM_BULK_FREE=y
CONFIG_BCM_LICENSE=m
CONFIG_BCM_RUNNER_FEED_RING_DYNAMIC=y
CONFIG_BCM_RUNNER_FEED_RING_SIZE=4096
CONFIG_BCM_RUNNER_FEED_RING_ALLOC_START=3072
CONFIG_BCM_RDPA_MCAST=y
CONFIG_BCM_RUNNER_MAX_FLOWS=16384
CONFIG_BCM_DEF_NR_RX_DMA_CHANNELS=2
CONFIG_BCM_DEF_NR_TX_DMA_CHANNELS=2
# CONFIG_BCM_BUILD_NGPON_AMD2 is not set
CONFIG_BCM_HS_UART=m
CONFIG_BCM_LOG=y
CONFIG_BCM_COLORIZE_PRINTS=y
CONFIG_BCM_I2C_BUS=y
CONFIG_BCM_VLAN=m
CONFIG_BCM_USBNET_ACCELERATION=y
CONFIG_BCM_USBNET_THREAD=y
CONFIG_BCM_WLAN=m
CONFIG_BCM_CPEROUTER=y
CONFIG_BCM_WLAN_DPDCTL=y
CONFIG_BCM_WLAN_64BITPHYSADDR=y
CONFIG_BCM_WLAN_WBD=y
CONFIG_BCM_WLALTBLD="default"
CONFIG_BCM_WLAN_IMPL=103
CONFIG_BCM_DEFAULT_NUM_MBSS=16
CONFIG_BCM_WLAN_MLO=y
CONFIG_BCM_PCI=y
CONFIG_BCM_ETH_PWRSAVE=y
CONFIG_BCM_ENERGY_EFFICIENT_ETHERNET=y
CONFIG_BCM_DDR_SELF_REFRESH_PWRSAVE=y
CONFIG_BCM_MAP=m
CONFIG_BCM_BOARD_IMPL=1
CONFIG_BCM_PLATFORM_IMPL=1
CONFIG_BCM_OTP_IMPL=1
CONFIG_BCM_EXT_TIMER_IMPL=1
CONFIG_BCM_PKTFLOW_IMPL=1
CONFIG_BCM_PKTRUNNER_IMPL=2
CONFIG_BCM_CMDLIST_IMPL=1
CONFIG_BCM_MPM_IMPL=1
CONFIG_BCM_INGQOS_IMPL=1
CONFIG_BCM_BPM_IMPL=1
CONFIG_BCM_LICENSE_IMPL=1
CONFIG_BCM_HS_UART_IMPL=2
CONFIG_BCM_LOG_IMPL=1
CONFIG_BCM_I2C_BUS_IMPL=1
CONFIG_BCM_VLAN_IMPL=1
CONFIG_BCM_MAP_IMPL=1
CONFIG_ROOT_FLASHFS="ro noinitrd"
CONFIG_BCM_JUMBO_FRAME=y
CONFIG_BCM_MAX_MTU_SIZE=10240
CONFIG_BCM_CPU_ARCH_NAME="armb53"
CONFIG_BCM_CPU_ARCH_ABI_NAME="aarch64"
CONFIG_BCM_BDMF=m
CONFIG_BCM_RDPA=m
CONFIG_BCM_RDPA_GPL=m
CONFIG_BCM_RDPA_USR=m
CONFIG_BCM_RDPA_GPL_EXT=m
CONFIG_BCM_RDPA_MW=m
CONFIG_BCM_RDPA_DRV=m
CONFIG_BCM_WIFI_FORWARDING_DRV=m
CONFIG_BCM_WLAN_NIC_RX_RNR_ACCEL=y
CONFIG_BCM_WLAN_16BIT_STATION_CHAIN_IDX_SUPPORT=y
CONFIG_BCM_PKTFWD=y
CONFIG_BCM_PKTFWD_FLCTL=y
CONFIG_BCM_WLAN_REMOVE_INTERNAL_DEBUG=y
CONFIG_BCM_WLAN_DGASP=y
CONFIG_BCM_GDX=m
CONFIG_BCM_GDX_HW=y
CONFIG_BCM_GDX_IMPL=1
CONFIG_BCM_DHD_RUNNER=y
CONFIG_BCM_RDPA_GPL_EXT_IMPL=1
CONFIG_BCM_WIFI_FORWARDING_DRV_IMPL=1
CONFIG_BCM_RDPA_MW_IMPL=1
CONFIG_BCM_RDPA_DRV_IMPL=1
CONFIG_BCM_ETHWAN=y
CONFIG_BCM_ETHTOOL=y
CONFIG_BCM_KERNEL_BONDING=y
CONFIG_BCM_CFE_XARGS=y
CONFIG_BCM_THERMAL=m
CONFIG_BCM_GLB_COHERENCY=y
CONFIG_BCM_XRDP_AUTOGATE=y
CONFIG_BCM_AIRIQ=y
CONFIG_BCM_HOSTAPD=y
CONFIG_NETFILTER_XT_TARGET_SKIPLOG=m
CONFIG_NETFILTER_XT_MATCH_BLOG=m
CONFIG_NETFILTER_XT_MATCH_FLOWLABEL=m
CONFIG_NF_DYNDSCP=m
CONFIG_BCM_NF_SCS=m
CONFIG_NF_MSCS=m
CONFIG_NF_CONNTRACK_RTSP=m
CONFIG_NF_NAT_PT=m
CONFIG_BRIDGE_EBT_TIME=y
CONFIG_BRIDGE_EBT_SKBVLAN=y
CONFIG_BRIDGE_EBT_BLOG=y
CONFIG_BRIDGE_EBT_FTOS_T=y
CONFIG_BRIDGE_EBT_SKIPLOG_T=y
CONFIG_BRIDGE_EBT_WMM_MARK=y
CONFIG_BRIDGE_EBT_QOS_MAP=y
CONFIG_BRIDGE_EBT_U32=y
CONFIG_BRIDGE_EBT_DSCP_T=y
CONFIG_BRIDGE_EBT_SKB_PRIORITY=y
CONFIG_BRIDGE_EBT_REJECT=y
CONFIG_BRIDGE_EBT_VTAG=y
CONFIG_BLOG=y
CONFIG_BLOG_MCAST=y
CONFIG_BLOG_GRE=y
CONFIG_BLOG_L2TP=y
CONFIG_BCM_SPU=m
CONFIG_BCM_SPU_IMPL=5
CONFIG_BCM_FLEXRM=m
CONFIG_BCM_FLEXRM_IMPL=1
CONFIG_BCM_SPU_HW_OFFLOAD=y
CONFIG_BCM_FLEXRM_V2_IRQ=y
CONFIG_BCM_PSCI=y
CONFIG_BCM_SELECTIVE_PHYS=y
CONFIG_BCM_PHY_BLACKFIN_B0=y
CONFIG_BCM_PHY_SHORTFIN_B0=y
CONFIG_BCM_PHY_KAUAI_A0=y
CONFIG_BCM_PHY_XPHY=y
CONFIG_BCM_DGASP_DRV=y
CONFIG_BCM_ARM_CPUIDLE=y
CONFIG_BCM_RESET_BUTTON=y
CONFIG_BCM_BCA_VREG_SYNC=y
CONFIG_BCM_GPS=y
CONFIG_BCM_BCA_GPIO=y
CONFIG_BCM_BCA_LED=y
CONFIG_BCM_OTP_DRV=y
CONFIG_BCM_COMMON_CLK=y
CONFIG_BCM_SFP=y
CONFIG_BCM_UBUS_DECODE_REMAP=y
CONFIG_BCM_UBUS4_DCM=y
CONFIG_BCM_BCA_EXTINTR=y
CONFIG_BCM_BCA_LEGACY_LED_API=y
CONFIG_BCM_BUTTON=y
CONFIG_BCM_PMC=y
CONFIG_BCM_STRAP=y
CONFIG_BCM_ENET=m
CONFIG_BCM_ENET_IMPL=7
CONFIG_BCM_BCA_USB=m
CONFIG_BCM_PCI_MSI=y
CONFIG_BCM_PCAP=m
CONFIG_BCM_OPTICALDET=y
CONFIG_BCM_PCM=y
CONFIG_BCM_BOOTSTATE=y
CONFIG_BCM_MCAST=m
CONFIG_BR_IGMP_SNOOP=y
CONFIG_BR_MLD_SNOOP=y
# CONFIG_BCM_SMTC is not set
```
